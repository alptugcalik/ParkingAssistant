SYSCTL_RCGCSSI 		EQU		0x400FE61C	
SSICR0				EQU		0x40008000
SSICR1				EQU		0x40008004
SSICPSR				EQU		0x40008010
SSIDR				EQU		0x40008008
SSISR				EQU		0x4000800C
GPIO_PORTB_DATA 	EQU 	0x400053FC ; Data						
			
			AREA		main, READONLY, CODE
            THUMB

			EXPORT		WRITE_COMMAND


; THIS SUBROUTINE SENDS COMMAND TO SCREEN
; COMMAND IS IN THE REGISTER R2

WRITE_COMMAND	PROC
	PUSH{LR}
	PUSH{R0,R1,R2}
			
	; SET COMMAND MODE BY CLEARING PB1
			LDR R1 , =GPIO_PORTB_DATA  
			LDR R0 , [R1]
			BIC R0, #0x2
			STR R0 , [R1]
	
			LDR R1,=SSISR
DON			LDR R0 , [R1]
			AND R0,#0x02 ; MASK TNF
			CMP R0,#0x02
			BEQ DVM
			B DON	
DVM	
	; WRITE THE DATA
			LDR R1,=SSIDR
			STR R2 ,[R1]
	
	; WAIT FOR TRANSMISSION	
			LDR R1,=SSISR
DON3		LDR R0 , [R1]
			AND R0,#0x11 ; MASK BSY AND TEF
			CMP R0,#0x01
			BEQ DVM3
			B DON3	
DVM3	
			POP{R0,R1,R2}
			POP{LR}	
			BX LR
			ENDP
			END