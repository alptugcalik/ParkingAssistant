			AREA		main, READONLY, CODE
            THUMB
				
			EXTERN GPIOINIT_A
			EXTERN GPIOINIT_B
			EXTERN GPIOINIT_F
			EXTERN INIT_SSI0
			EXTERN DELAY100
			EXTERN WAVE_PROP
			EXTERN INIT_SCREEN
			EXTERN WRITE_DISPLAY
			EXTERN INIT_TIMER1
			EXTERN INIT_ADC
			EXTERN READ_ANALOG
			EXTERN CONVRT_DIGITAL
			EXTERN InitSysTick
			EXTERN OutStr
			EXTERN UPDATE_OP
			EXTERN UPDATE_BAR
			EXTERN UPDATE_MEAS
			EXTERN DELAY1
			EXPORT GPIO_ISR
				

GPIO_PORTF_ICR 		EQU 	0x4002541C
GPIO_PORTF_DATA 	EQU 	0x400253FC ; data address to all pins SPECIFIED WITH REQUIRED MASK
NVIC_ST_CTRL 		EQU 	0xE000E010
TIMER2_CTL 			EQU 0x4003200C ; Control Register 
	
GPIO_ISR	PROC
		PUSH{LR}
		PUSH{R4,R5,R6,R7,R8,R9}

	; DEBOUNCING
TKR		LDR R0,=GPIO_PORTF_DATA
		LDR R1,[r0]
		BL DELAY1
		LDR R0,=GPIO_PORTF_DATA
		LDR R2,[r0]
		CMP R1,R2
		BNE TKR
		AND R1,#0x11 ; MASK SWITHCES
		CMP R1,#0x10
		BEQ GEC
		
; IF SW1 IS PRESSED
		; FIRST CHECK THE CURRENT STATE
		LDR R5,=0x20000550
		LDRB R5,[R5]
		; NORMAL STATE -> GO TO THRESHOLD STATE
		CMP R5,#0
		BNE IKI
		; CONFIGURE THE STATE
		LDR R3,=0x20000550
		MOV R2,#1
		STRB R2,[R3]
		; UPDATE DISPLAY
		BL UPDATE_OP
		; UPDATE BAR
		BL UPDATE_BAR
		; UPDATE MEASURE
		BL UPDATE_MEAS
		B OHO
IKI		; THRESHOLD SETTING STATE -> GO TO NORMAL STATE AND CHANGE THRESHOLD
		; THRESHOLD SETTING STATE
		CMP R5,#1
		BNE UC
		; CONFIGURE THE STATE TO NORMAL STATE
		LDR R3,=0x20000550
		MOV R2,#0
		STRB R2,[R3]
		; UPDATE DISPLAY
		BL UPDATE_OP
		B OHO
UC		; PREVENTATIVE BREAKING -> NO OPERATION		
		B OHO
		
		
; IF SW2 IS PRESSED -> GO NORMAL STATE		
GEC		
		; FIRST CHECK THE CURRENT STATE
		LDR R5,=0x20000550
		LDRB R5,[R5]
		CMP R5,#2
		BNE OHO
		; PREVENTATIVE BREAKING
		; ENABLE THE TIMER2A
		; Enable timer 
		LDR R1, =TIMER2_CTL ; 
		LDR R2, [R1] ; 
		ORR R2, R2, #0x01				 ; set bit 0 to enable 
		STR R2, [R1] 
		; CONFIGURE THE STATE TO NORMAL STATE
		LDR R3,=0x20000550
		MOV R2,#0
		STRB R2,[R3]
		; UPDATE DISPLAY
		BL UPDATE_OP
OHO		
		LDR R1, =GPIO_PORTF_ICR ; CLEAR INTERRUPT
		MOV R0,#0x11 ; BOTH FOR SW1 AND SW2
		STR R0 ,[R1]
		
		
		POP{R4,R5,R6,R7,R8,R9}
		POP{LR}	
		BX LR
		ENDP
		END