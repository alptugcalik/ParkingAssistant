SYSCTL_RCGCGPIO		EQU		0x400FE608 ;SYSTEM GPIO CLOCK
GPIO_PORTF_DATA 	EQU 	0x400253FC ; data address to all pins SPECIFIED WITH REQUIRED MASK 
GPIO_PORTF_DIR 		EQU 	0x40025400
GPIO_PORTF_IS 		EQU 	0x40025404
GPIO_PORTF_IBE		EQU 	0x40025408
GPIO_PORTF_IEV 		EQU 	0x4002540C
GPIO_PORTF_IM 		EQU 	0x40025410
GPIO_PORTF_ICR 		EQU 	0x4002541C
GPIO_PORTF_AFSEL 	EQU 	0x40025420
GPIO_PORTF_AMSEL 	EQU 	0x40025428
GPIO_PORTF_DEN 		EQU 	0x4002551C
GPIO_PORTF_PUR 		EQU 	0x40025510 
IOF 				EQU 	0x00000000 ;INPUT CONFIG OF PORT F
GPIO_PORTF_LOCK		EQU		0x40025520
GPIO_PORTF_COMMIT	EQU		0x40025524
NVIC_EN0			EQU		0xE000E100

			AREA		main, READONLY, CODE
            THUMB

			EXPORT		GPIOINIT_F


GPIOINIT_F	PROC

			;ENABLE CLOCK FIRST
			LDR R1,=SYSCTL_RCGCGPIO
			LDR R0,[R1]
			ORR R0,#0x20; turn on clock for F port
			STR R0 ,[R1]
			NOP
			NOP
			nop
			
			LDR R1 , =GPIO_PORTF_LOCK ;unlock
			LDR R0 , =0x4C4F434B
			STR R0 , [R1]
			
			LDR R1, =GPIO_PORTF_COMMIT ; direction register address
			LDR R0,[R1] ;direction register data
			ORR R0,#0x11
			STR R0 ,[R1]
			
			LDR R1, =GPIO_PORTF_DIR ; direction register address
			LDR R0,[R1] ;direction register data
			BIC R0,#IOF
			STR R0 ,[R1]
						
			LDR R1 , =GPIO_PORTF_AFSEL ;no alternative function
			LDR R0 , [R1]	
			BIC R0 , #0xFF   ;CLEAR AFSEL OF PORT F
			STR R0 , [R1]
			
			LDR R1 , =GPIO_PORTF_DEN  ;all pins are dgital
			LDR R0 , [R1]
			MOV R0 , #0xFF  ;CONFIG DIGITAL PINS
			STR R0 , [R1]
			
			LDR R1 , =GPIO_PORTF_AMSEL ;no aNALOG PIN function
			LDR R0 , [R1]	
			BIC R0 , #0xFF   ;CLEAR AMSEL OF PORT F
			STR R0 , [R1]
			
			LDR R1, =GPIO_PORTF_PUR ; ASSIGN PULL UPS TO SWITCHES
			MOV R0,#0x11
			STR R0 ,[R1]

			LDR R1, =GPIO_PORTF_IS ; SET INTERRUPTS FOR SWITCHES
			MOV R0,#0x0 ; BOTH FOR SW1 AND SW2 (EDGE SENSITIVE)
			STR R0 ,[R1]
			
			LDR R1, =GPIO_PORTF_IBE ; SET INTERRUPTS FOR SWITCHES
			MOV R0,#0x0 ; BOTH FOR SW1 AND SW2 (NOT BOTH EDGES)
			STR R0 ,[R1]
			
			LDR R1, =GPIO_PORTF_IEV ; SET INTERRUPTS EVENTS
			MOV R0,#0x0 ; SENSE WHEN THE INPUT IS LOW (FALLING EDGE)
			STR R0 ,[R1]
			
			LDR R1, =GPIO_PORTF_IM ; SET INTERRUPTS FOR SWITCHES
			MOV R0,#0x11 ; ENABLE BOTH FOR SW1 AND SW2
			STR R0 ,[R1]
			
			LDR R1, =GPIO_PORTF_ICR ; SET INTERRUPTS FOR SWITCHES
			MOV R0,#0x11 ; CLEAR FLAG BOTH FOR SW1 AND SW2
			STR R0 ,[R1]
			
			LDR R1, =NVIC_EN0 ; SET INTERRUPTS FOR SWITCHES
			LDR R0,[R1]
			ORR R0,#0x40000000 ; ENABLE INTERRUPT FOR PORT F
			STR R0 ,[R1]
			
			BX LR
			ENDP
			END